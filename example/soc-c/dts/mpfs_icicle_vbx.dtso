/dts-v1/;
/plugin/;
/ { 
	fragment@0 {
		target-path="/";
		__overlay__ {
			vbx@60030000 {
				compatible = "generic-uio";
				reg = <0x0 0x60030000 0x0 0x1000>;
				status = "okay";
			};
		};
	};
};
